## config/west.yml
```yaml
manifest:
  defaults:
    revision: v0.3
  remotes:
    - name: zmkfirmware
      url-base: https://github.com/zmkfirmware
    - name: BlueDrink9  # 새로 추가
      url-base: https://github.com/BlueDrink9
    # Additional modules containing boards/shields/custom code can be listed here as well
    # See https://docs.zephyrproject.org/3.2.0/develop/west/manifest.html#projects
  projects:
    - name: zmk
      remote: zmkfirmware
      import: app/west.yml
    - name: zmk-poor-mans-led-indicator  # 새로 추가
      remote: BlueDrink9
      revision: main
      path: modules/zmk-poor-mans-led-indicator
  self:
    path: config
```
